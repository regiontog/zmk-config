## config/boards/shields/hedon/Kconfig.defconfig
```kconfig
# Copyright (c) 2022 The ZMK Contributors
# SPDX-License-Identifier: MIT

if SHIELD_HEDON_LEFT

config ZMK_KEYBOARD_NAME
	default "hedon"

config ZMK_SPLIT_BLE_ROLE_CENTRAL
	default y

endif

if SHIELD_HEDON_LEFT || SHIELD_HEDON_RIGHT

config ZMK_SPLIT
	default y

endif
```

## config/boards/shields/hedon/Kconfig.shield
```kconfig
# Copyright (c) 2022 The ZMK Contributors
# SPDX-License-Identifier: MIT

config SHIELD_HEDON_LEFT
	def_bool $(shields_list_contains,hedon_left)

config SHIELD_HEDON_RIGHT
	def_bool $(shields_list_contains,hedon_right)
```
